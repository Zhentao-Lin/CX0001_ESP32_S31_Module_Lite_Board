## 03.Sketch/01_GPIO_LED/main/Kconfig.projbuild
```kconfig
menu "Example Configuration"

    orsource "$IDF_PATH/examples/common_components/env_caps/$IDF_TARGET/Kconfig.env_caps"

    config BLINK_GPIO
        int "Blink GPIO number"
        range ENV_GPIO_RANGE_MIN ENV_GPIO_OUT_RANGE_MAX
        default 38
        help
            GPIO number (e.g. GPIO_NUM_38) to which the LED is connected.

            Default is 38, the on-board LED of the CX-ESP32-S31 board.
            Change it via 'idf.py menuconfig' if the LED is wired elsewhere.

    config BLINK_DELAY_MS
        int "Blink interval (ms)"
        range 1 10000
        default 300
        help
            Time in milliseconds the LED stays ON, and also stays OFF,
            before toggling again.

            Default is 300 ms, i.e. the LED blinks every 0.3 s.

endmenu
```

## 03.Sketch/02_GPIO_BUTTON/main/Kconfig.projbuild
```kconfig
menu "Example Configuration"

    orsource "$IDF_PATH/examples/common_components/env_caps/$IDF_TARGET/Kconfig.env_caps"

    config BUTTON_GPIO
        int "Button GPIO number"
        range ENV_GPIO_RANGE_MIN ENV_GPIO_IN_RANGE_MAX
        default 61
        help
            GPIO number to which the on-board BOOT key is connected.

            Default is 61, the BOOT key of the CX-ESP32-S31 board.
            The key shorts the pin to GND, so it is active low.
            Change it via 'idf.py menuconfig' if the key is wired elsewhere.

    config LED_GPIO
        int "LED GPIO number"
        range ENV_GPIO_RANGE_MIN ENV_GPIO_OUT_RANGE_MAX
        default 38
        help
            GPIO number of the on-board LED, toggled on every valid press.

            Default is 38, the on-board LED of the CX-ESP32-S31 board.

endmenu
```

## 03.Sketch/03_WS2812/main/Kconfig.projbuild
```kconfig
menu "Example Configuration"

    orsource "$IDF_PATH/examples/common_components/env_caps/$IDF_TARGET/Kconfig.env_caps"

    config WS2812_GPIO
        int "WS2812 data line GPIO number"
        range ENV_GPIO_RANGE_MIN ENV_GPIO_OUT_RANGE_MAX
        default 39
        help
            GPIO number (e.g. GPIO_NUM_39) the on-board WS2812 data line is connected to.

            Default is 39, the WS2812 data pin of the CX-ESP32-S31 board.
            Change it via 'idf.py menuconfig' if the LED chain is wired elsewhere.

    config WS2812_LED_NUM
        int "Number of WS2812 LEDs in the chain"
        range 1 1024
        default 1
        help
            Number of addressable RGB LEDs driven through the data line, i.e. the
            number of pixels the driver keeps a buffer for (valid indices 0..N-1).

            Default is 1: the CX-ESP32-S31 board carries a single on-board WS2812.
            Set it to the length of your strip when an external chain is wired.

    config WS2812_BRIGHTNESS
        int "Brightness (0-255, 50 is about 20%)"
        range 0 255
        default 50
        help
            Brightness applied to every colour channel, on the same 0-255 scale as
            Arduino's setBrightness(). 50 lights the LED at about 20% of full scale,
            which is comfortable for a single on-board LED.

    config WS2812_STEP_MS
        int "Colour step duration (ms)"
        range 1 10000
        default 300
        help
            Time in milliseconds each colour (red / green / blue / white / off)
            stays on before the next one is shown.

            Default is 300 ms.

    config WS2812_RMT_RES_HZ
        int "RMT resolution (Hz)"
        default 10000000
        range 1000000 80000000
        help
            Resolution of the RMT channel used to generate the WS2812 waveform.

            Default is 10000000 (10 MHz), i.e. 1 tick = 0.1 us, which encodes the
            0.4 us / 0.8 us bit timing exactly. A lower resolution loses timing
            accuracy and makes the LED flicker or show wrong colours.

            Keep the default unless you know what the driver expects.

endmenu
```

## 03.Sketch/04_USB_SERIAL/main/Kconfig.projbuild
```kconfig
menu "Example Configuration"

    orsource "$IDF_PATH/examples/common_components/env_caps/$IDF_TARGET/Kconfig.env_caps"

    config LED_GPIO
        int "LED GPIO number"
        range ENV_GPIO_RANGE_MIN ENV_GPIO_OUT_RANGE_MAX
        default 38
        help
            GPIO number of the on-board LED driven by the "led on" / "led off" commands.

            Default is 38, the on-board LED of the CX-ESP32-S31 board.
            Change it via 'idf.py menuconfig' if the LED is wired elsewhere.

endmenu
```

## 03.Sketch/08_WIFI_SOCKET/main/Kconfig.projbuild
```kconfig
menu "Wi-Fi station example"

    config EXAMPLE_WIFI_SSID
        string "Wi-Fi SSID"
        default "myssid"
        help
            Name of the 2.4 GHz access point to join. The ESP32-C6 coprocessor has no 5 GHz
            radio, so a 5 GHz-only SSID will never be found.

    config EXAMPLE_WIFI_PASSWORD
        string "Wi-Fi password"
        default "mypassword"
        help
            WPA2 passphrase. Leave empty for an open network; the example then lowers the
            authentication threshold to WIFI_AUTH_OPEN.

    config EXAMPLE_WIFI_MAX_RETRY
        int "Maximum reconnect attempts"
        range 1 20
        default 5
        help
            How many times esp_wifi_connect() is retried after a disconnect before the example
            gives up and reports failure.

endmenu

menu "Socket example"

    choice EXAMPLE_SOCKET_MODE
        prompt "Socket mode"
        default EXAMPLE_SOCKET_MODE_TCP_SERVER
        help
            What the socket section does once the station has an IP:

            - TCP server: the board listens on a TCP port and takes one peer at a time.
            - TCP client: the board connects out to a remote IPv4 address and port.
            - UDP echo:   the board answers every datagram back to its sender, and broadcasts
              console traffic to every host on the LAN.

            All three modes bridge the link with the USB-Serial/JTAG console: a line typed and
            finished with Enter is sent to the peer, and whatever the peer sends is printed back
            on the console as one log line. UDP keeps its echo on top of that, so a peer sees both
            the echo of its own datagram and the broadcast console traffic.

    config EXAMPLE_SOCKET_MODE_TCP_SERVER
        bool "TCP server (console <-> peer, bidirectional)"
    config EXAMPLE_SOCKET_MODE_TCP_CLIENT
        bool "TCP client (console <-> peer, bidirectional)"
    config EXAMPLE_SOCKET_MODE_UDP
        bool "UDP echo server (echo each datagram back)"
    endchoice

    config EXAMPLE_TCP_PORT
        int "TCP listen port"
        depends on EXAMPLE_SOCKET_MODE_TCP_SERVER
        default 3333
        help
            TCP port the board listens on for incoming connections.

    config EXAMPLE_REMOTE_IP
        string "Remote IPv4 address"
        depends on EXAMPLE_SOCKET_MODE_TCP_CLIENT
        default "192.168.1.100"
        help
            Dotted-quad address of the host running the remote socket server. The connection is
            retried every 2 seconds until that address answers, so the server may be started after
            the board has booted.

            UDP mode does not use this field - it has no peer to dial, so console traffic goes to
            the broadcast address instead.

    config EXAMPLE_REMOTE_PORT
        int "Remote / broadcast port"
        depends on EXAMPLE_SOCKET_MODE_TCP_CLIENT || EXAMPLE_SOCKET_MODE_UDP
        default 3333
        help
            In TCP client mode: the TCP port on the remote host to connect to.

            In UDP mode: the destination port of the broadcast - every host on the LAN that
            listens for datagrams on this port receives the lines typed on the console.

    config EXAMPLE_UDP_PORT
        int "UDP listen port"
        depends on EXAMPLE_SOCKET_MODE_UDP
        default 3334
        help
            UDP port the board binds. Each datagram received on it is sent back to its sender.
            Console traffic leaves from this socket towards the broadcast port above, so the two
            ports are independent: peers talk to the board on this one, the board talks to the
            LAN on that one.

endmenu
```

## 03.Sketch/09_WEB_WS2812/main/Kconfig.projbuild
```kconfig
menu "Wi-Fi station example"

    config EXAMPLE_WIFI_SSID
        string "Wi-Fi SSID"
        default "myssid"
        help
            Name of the 2.4 GHz access point to join. The ESP32-S31 example uses the 2.4 GHz
            band, so a 5 GHz-only SSID will never be found.

    config EXAMPLE_WIFI_PASSWORD
        string "Wi-Fi password"
        default "mypassword"
        help
            WPA2 passphrase. Leave empty for an open network; the example then lowers the
            authentication threshold to WIFI_AUTH_OPEN.

    config EXAMPLE_WIFI_MAX_RETRY
        int "Maximum reconnect attempts"
        range 1 20
        default 5
        help
            How many times esp_wifi_connect() is retried after a disconnect before the example
            gives up and reports failure.

endmenu

menu "WS2812 web example"

    config EXAMPLE_WS2812_GPIO
        int "WS2812 data GPIO"
        default 39
        help
            GPIO number connected to the WS2812 DIN pin.

    config EXAMPLE_WS2812_BRIGHTNESS
        int "WS2812 brightness (0-255)"
        range 0 255
        default 50
        help
            LED brightness for each active colour channel. 50 ~ 20 %% of full on.

    config EXAMPLE_HTTP_PORT
        int "HTTP listen port"
        default 80
        help
            TCP port the built-in HTTP server listens on. Default 80 lets a browser open
            the board IP directly (http://<board-ip>). Change it (e.g. 8080) if port 80 is
            taken or blocked on your network.

endmenu
```
